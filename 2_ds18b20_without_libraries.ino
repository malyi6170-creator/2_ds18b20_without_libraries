// Определяем пины, к которым подключены линии DATA двух датчиков DS18B20
const uint8_t PIN_SENSOR_1 = 2; // Первый датчик на контакте D2
const uint8_t PIN_SENSOR_2 = 3; // Второй датчик на контакте D3

// Переменные для реализации неблокирующего таймера (замена задержки delay)
unsigned long lastConversionTime = 0; // Время (в мс) последнего вызова команды Convert T
bool isConverting = false;            // Флаг: выполняется ли прямо сейчас замер температуры

// --- НИЗКОУРОВНЕВЫЕ ФУНКЦИИ ПРОТОКОЛА ONEWIRE С ПОДДЕРЖКОЙ ПИНОВ ---

// 1. Импульс сброса (Reset) и проверка ответа от датчика (Presence) для конкретного пина
bool onewire_reset(uint8_t pin) {
  bool presence = false; // Переменная для хранения флага ответа от датчика

  // Отключаем аппаратные прерывания (millis, Serial и др.),
  // чтобы системные таймеры не сбили критичные микросекундные задержки
  noInterrupts();

  pinMode(pin, OUTPUT);      // Конфигурируем пин как выход
  digitalWrite(pin, LOW);    // Притягиваем шину к 0V (начинаем импульс Reset)
  delayMicroseconds(480);    // Удерживаем LOW минимум 480 мкс по спецификации OneWire

  pinMode(pin, INPUT);       // Переводим пин в режим входа (отпускаем шину к 5V/3.3V)
  delayMicroseconds(70);     // Ждем 70 мкс перед считыванием ответа от датчика

  // Если датчик исправен и подключен, он притянет шину к LOW в ответ на Reset
  presence = !digitalRead(pin);
  
  // Возвращаем обработку прерываний сразу после считывания ответа
  interrupts();

  delayMicroseconds(410);    // Дожидаемся завершения полного цикла Reset (суммарно 480 мкс)
  return presence;           // true = датчик обнаружен, false = ошибка на шине
}

// 2. Функция записи одного бита данных на выбранный пин
void onewire_write_bit(uint8_t pin, uint8_t bit) {
  noInterrupts();            // Защита критической секции тайм-слота от прерываний
  pinMode(pin, OUTPUT);      // Настраиваем пин на выход
  digitalWrite(pin, LOW);    // Притягиваем шину к 0V (сигнал начала тайм-слота)

  if (bit) {
    // Передача логической '1'
    delayMicroseconds(6);    // Удерживаем LOW от 1 до 15 мкс (оптимально ~6 мкс)
    pinMode(pin, INPUT);     // Отпускаем шину в состояние HIGH (подтяжка резистором)
    interrupts();            // Разрешаем прерывания
    delayMicroseconds(64);   // Дожидаемся окончания тайм-слота (минимум 60 мкс)
  } else {
    // Передача логического '0'
    delayMicroseconds(60);   // Удерживаем LOW в течение всего тайм-слота (60–120 мкс)
    pinMode(pin, INPUT);     // Отпускаем шину
    interrupts();            // Разрешаем прерывания
    delayMicroseconds(10);   // Пауза восстановления между слотами (Recovery time)
  }
}

// 3. Функция чтения одного бита данных с выбранного пина
uint8_t onewire_read_bit(uint8_t pin) {
  uint8_t bit = 0; // Переменная для сохранения прочитанного бита (0 или 1)

  noInterrupts();            // Защита критической секции тайм-слота от прерываний
  pinMode(pin, OUTPUT);      // Настраиваем пин на выход
  digitalWrite(pin, LOW);    // Притягиваем шину к 0V для запроса бита
  delayMicroseconds(3);      // Удерживаем LOW не менее 1 мкс (оптимально 3 мкс)

  pinMode(pin, INPUT);       // Отпускаем шину (подтягивающий резистор возвращает HIGH)
  delayMicroseconds(9);      // Пауза перед считыванием (считываем строго на ~12 мкс от начала)

  if (digitalRead(pin)) {    // Если датчик отпустил шину — это '1', если держит — '0'
    bit = 1;
  }
  interrupts();              // Разрешаем прерывания

  delayMicroseconds(55);     // Завершаем полный тайм-слот чтения (~70 мкс)
  return bit;                // Возвращаем прочитанный бит
}

// 4. Последовательная отправка байта (8 бит) на выбранный пин, начиная с младшего бита (LSB)
void onewire_write_byte(uint8_t pin, uint8_t data) {
  for (uint8_t i = 0; i < 8; i++) {
    onewire_write_bit(pin, data & 0x01); // Извлекаем младший бит и отправляем на шину
    data >>= 1;                          // Сдвигаем байт вправо для получения следующего бита
  }
}

// 5. Последовательное чтение байта (8 бит) с выбранного пина, начиная с младшего бита (LSB)
uint8_t onewire_read_byte(uint8_t pin) {
  uint8_t data = 0; // Переменная для сборки прочитанного байта
  for (uint8_t i = 0; i < 8; i++) {
    if (onewire_read_bit(pin)) {
      data |= (1 << i); // Устанавливаем i-й бит в '1', если с шины прочитана единица
    }
  }
  return data; // Возвращаем полностью собранный байт
}

// --- ФУНКЦИИ ВЕРХНЕГО УРОВНЯ ДЛЯ DS18B20 ---

// Запуск измерения температуры на конкретном пине
void ds18b20_start_conversion(uint8_t pin) {
  if (onewire_reset(pin)) {          // Проверяем наличие датчика на шине
    onewire_write_byte(pin, 0xCC);   // Команда Skip ROM (пропуск адресации, так как на пине один датчик)
    onewire_write_byte(pin, 0x44);   // Команда Convert T (запуск процесса измерения температуры)
  }
}

// Чтение измеренной температуры из оперативной памяти (Scratchpad) конкретного пина
float ds18b20_read_temperature(uint8_t pin) {
  if (!onewire_reset(pin)) return -999.0; // Возвращаем признак ошибки, если датчик не ответил

  onewire_write_byte(pin, 0xCC);   // Команда Skip ROM
  onewire_write_byte(pin, 0xBE);   // Команда Read Scratchpad (чтение блока памяти датчика)

  // Читаем первые два байта из памяти, где хранится результат измерения
  uint8_t lowByte = onewire_read_byte(pin);  // Младший байт температуры
  uint8_t highByte = onewire_read_byte(pin); // Старший байт температуры

  // Объединяем два 8-битных значения в одно 16-битное число со знаком
  int16_t rawTemperature = (highByte << 8) | lowByte;

  // Фильтрация заводского значения по умолчанию: 0x0500 соответствует 85.0 °C.
  // Выдается, если чтение вызвано до окончания замера или при сбое питания.
  if (rawTemperature == 0x0500) {
    return -999.0; // Возвращаем код ошибки для повторного запроса
  }

  // Расчет итоговой температуры: 1 младший разряд (LSB) равен 0.0625 °C (1/16 градуса)
  return rawTemperature * 0.0625;
}

// --- ИНИЦИАЛИЗАЦИЯ И ОСНОВНОЙ ЦИКЛ ---

void setup() {
  Serial.begin(9600);           // Инициализация последовательного порта на скорости 9600 бод
  pinMode(LED_BUILTIN, OUTPUT); // Конфигурируем пин встроенного светодиода как выход
  
  Serial.println("=== Схема на колене ===");
  Serial.println("DS18B20 (2 датчика на разных пинах) запущен!");

  // Запускаем первые замеры температуры на обоих датчиках при старте
  ds18b20_start_conversion(PIN_SENSOR_1);
  ds18b20_start_conversion(PIN_SENSOR_2);
  
  lastConversionTime = millis(); // Фиксируем время старта замера
  isConverting = true;           // Устанавливаем флаг активности процесса замера
}

void loop() {
  // Неблокирующий таймер: проверяем, прошло ли 800 мс с момента запроса замера
  // (Максимальное время преобразования для 12-битного разрешения составляет 750 мс)
  if (isConverting && (millis() - lastConversionTime >= 800)) {
    // Считываем результаты замера с обоих датчиков
    float temp1 = ds18b20_read_temperature(PIN_SENSOR_1);
    float temp2 = ds18b20_read_temperature(PIN_SENSOR_2);

    // Вывод результатов в одну строку с фирменной подписью канала
    Serial.print("[Схема на колене]  Sensor 1: ");
    if (temp1 != -999.0) {
      Serial.print(temp1, 1);   // Вывод температуры с 1 знаком после запятой
      Serial.print(" °C");
    } else {
      Serial.print("Ошибка");  // Сообщение при сбое чтения первого датчика
    }

    Serial.print("  |  Sensor 2: ");
    if (temp2 != -999.0) {
      Serial.print(temp2, 1);   // Вывод температуры с 1 знаком после запятой
      Serial.println(" °C");
    } else {
      Serial.println("Ошибка"); // Сообщение при сбое чтения второго датчика
    }

    // Сразу инициируем следующие замеры на обоих датчиках
    ds18b20_start_conversion(PIN_SENSOR_1);
    ds18b20_start_conversion(PIN_SENSOR_2);
    
    lastConversionTime = millis(); // Обновляем метку времени последнего запуска
  }

  // Демонстрация фоновой работы: мигаем встроенным светодиодом каждые 100 мс без delay()
  static unsigned long ledTimer = 0;
  if (millis() - ledTimer >= 100) {
    ledTimer = millis();                                   // Обновляем таймер светодиода
    digitalWrite(LED_BUILTIN, !digitalRead(LED_BUILTIN)); // Инвертируем состояние пина
  }
}
